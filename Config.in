## package/amtrak-tracker-led-tester/Config.in
```kconfig
config BR2_PACKAGE_AMTRAK_TRACKER_LED_TESTER
    bool "amtrak-tracker-led-tester"
    depends on BR2_PACKAGE_HOST_RUSTC_TARGET_ARCH_SUPPORTS
 	  select BR2_PACKAGE_HOST_RUSTC
    help
      A simple test application for APA102 LEDs on the Amtrak Tracker board.
```

## package/led-test/Config.in
```kconfig
config BR2_PACKAGE_LED_TEST
    bool "led-test"
    help
      A simple test application for APA102 LEDs
```

## package/providence/Config.in
```kconfig
config BR2_PACKAGE_PROVIDENCE
    bool "providence"
    depends on BR2_PACKAGE_HOST_RUSTC_TARGET_ARCH_SUPPORTS
 	  select BR2_PACKAGE_HOST_RUSTC
    help
      An all-in-one wifi provisioning solution.
```

## package/wifi-connect/Config.in
```kconfig
config BR2_PACKAGE_WIFI_CONNECT
    bool "wifi-connect"
    depends on BR2_PACKAGE_HOST_RUSTC_TARGET_ARCH_SUPPORTS
    depends on BR2_PACKAGE_NETWORK_MANAGER
 	  select BR2_PACKAGE_HOST_RUSTC
    help
      An application that provides a captive portal mechanism to provision a device to a wifi network.
```
